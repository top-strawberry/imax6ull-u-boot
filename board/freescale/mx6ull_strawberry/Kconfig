## board/freescale/mx6ull_strawberry/Kconfig
```kconfig
if TARGET_MX6ULL_STRAWBERRY

config SYS_BOARD
	default "mx6ull_strawberry"

config SYS_VENDOR
	default "freescale"

config SYS_CONFIG_NAME
	default "mx6ull_strawberry"

endif
```
